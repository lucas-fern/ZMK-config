## config/boards/shields/mole/Kconfig.defconfig
```kconfig
if SHIELD_MOLE_LEFT

config ZMK_KEYBOARD_NAME
    default "mole"

config ZMK_SPLIT_BLE_ROLE_CENTRAL
    default y

endif

if SHIELD_MOLE_LEFT || SHIELD_MOLE_RIGHT

config ZMK_SPLIT
    default y

endif
```

## config/boards/shields/mole/Kconfig.shield
```kconfig
config SHIELD_MOLE_LEFT
    def_bool $(shields_list_contains,mole_left)

config SHIELD_MOLE_RIGHT
    def_bool $(shields_list_contains,mole_right)
```
